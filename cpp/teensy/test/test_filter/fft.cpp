#include <Arduino.h>
#include "arm_math.h"
#include "arm_const_structs.h"
#define SAMPLE_RATE 510000
#define SAMPLE_LENGTH 1024
#define BITSHiFT 9
#define SCALE_FACTOR 1000.0

int16_t samples_raw[SAMPLE_LENGTH] = {
3276, 1192, -3276, 1333, 3276, -3276, 2066, -3276, -3276, -3262, 3276, 2179,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 3328
};
int16_t samples[SAMPLE_LENGTH];

//int16_t samples[SAMPLE_LENGTH];
int16_t resultsRaw[2*SAMPLE_LENGTH]; //To store the results of fft with complex numbers, need to have double the size of the sample length z = a + bi, {a1, b1, a2, b2, a3, b3 ... }
uint32_t ifftFlag = 0;
uint32_t doBitReverse = 1;
arm_rfft_instance_q15 fft_instance;
int16_t results[SAMPLE_LENGTH]; //


void setup() {
Serial.begin(9600); // Initialize the FFT
Serial.println("Serial output begun");

int fOrder = 9;

//Coefficients found at https://www.meme.net.au/butterworth.html, put 9th order filter, 510kHz sampling rate and 50kHz cut-off
float32_t aFilterCoeffs[fOrder] = {
  5.4569203401896500,
  -13.7047980216478000,
  20.6476635308150000,
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  -0.3350397779275800,
  0.0267111235596287
};

float32_t bFilterCoeffs[fOrder + 1] = {
  0.00000545381633879714,
  0.00004908434704917420,
  0.00019633738819669700,
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  0.00004908434704917420,
  0.00000545381633879714
};


/*
  Implement Buterwirth filter of "fOrder"
  y = (a_1 * y_1 + .... + a_n * y_n) + (b_1 * x_1 + ... b_m * x_m)
  Se Wiki: [Wiki Page]
  Se source: https://www.meme.net.au/butterworth.html
*/

//Iterate through each index of the raw samples, and apply filtering to them. Starting at fOrder because we can't use an index outside of the samples array
for (int i = fOrder; i < SAMPLE_LENGTH + fOrder; i++)
{
  float32_t output_influence = 0;
  for (int k = 0; k < fOrder; k++)
  {
    output_influence += aFilterCoeffs[k]*samples[i-(k+1)];
  }

  float32_t input_influence = 0;
  for (int k = 0; k < fOrder + 1; k++)
  {
    input_influence += bFilterCoeffs[k]*samples_raw[i-k];
  }

  samples[i] = (int16_t)(output_influence + input_influence);
  
  Serial.print(samples[i]); Serial.print(", ");
}
Serial.println("Filtered");


arm_rfft_init_q15(&fft_instance, SAMPLE_LENGTH, ifftFlag, doBitReverse);
Serial.println("rfft initialized");
arm_scale_q15(samples, SCALE_FACTOR, BITSHiFT, samples, SAMPLE_LENGTH); //Scale samples

Serial.println("Made samples"); //For troubleshooting
arm_rfft_q15(&fft_instance, samples, resultsRaw); // The result of the FFT is stored in the results array
Serial.println("Results created");
// Use the magnitude function to compute the magnitude of the complex result
arm_cmplx_mag_q15(resultsRaw, results, SAMPLE_LENGTH); // Convert the magnitude to dB and store in the samples array

Serial.println("fft output"); //Printing the fft output for a better understanding of what is going on
for(int i = 0; i < SAMPLE_LENGTH; i++){
Serial.print(results[i]);
if(i < (SAMPLE_LENGTH - 1)){
Serial.print(", ");
} else{
Serial.println("");
}
}

Serial.print("Frequencies: ");
for (int i = 0; i < SAMPLE_LENGTH/2; i++)
{
if(results[i] > 0){
float total_amp = results[i] + results[i+1]; //Calculate total amplitude of neighboring non-zero indexes.
float prop1 = results[i]/total_amp; //Calculate proportion of index 1 amplitude to total amplitude
float prop2 = results[i+1]/total_amp; //Ditto for index 2
float temp_freq = (float)(prop1*i * SAMPLE_RATE / SAMPLE_LENGTH) + (float)(prop2*(i+1) * SAMPLE_RATE / SAMPLE_LENGTH); //We use the proportions instead of the straight average of 2s
Serial.print(temp_freq); 
Serial.print(", ");
i++;
}
}
Serial.println("");

}

void loop() {}
